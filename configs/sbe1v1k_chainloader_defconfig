## configs/sbe1v1k_chainloader_defconfig
```kconfig
CONFIG_ARM=y
CONFIG_SKIP_LOWLEVEL_INIT=y
CONFIG_POSITION_INDEPENDENT=y
CONFIG_SYS_INIT_SP_BSS_OFFSET=0x180000
CONFIG_ARCH_SNAPDRAGON=y
CONFIG_SYS_BOARD="sbe1v1k-chainloader"
CONFIG_SYS_CONFIG_NAME="qcom"
CONFIG_TEXT_BASE=0x4A240000
CONFIG_NR_DRAM_BANKS=24
CONFIG_ENV_SIZE=0x40000
CONFIG_ENV_OFFSET=0
CONFIG_DEFAULT_DEVICE_TREE="qcom/ipq9570-sbe1v1k"
CONFIG_SYS_LOAD_ADDR=0x60000000
CONFIG_DEBUG_UART_BASE=0x78b1000
CONFIG_DEBUG_UART_CLOCK=1843200
CONFIG_DEBUG_UART=y
CONFIG_REMAKE_ELF=y
# CONFIG_EFI_LOADER is not set
CONFIG_FIT=y
CONFIG_FIT_VERBOSE=y
# CONFIG_BOOTSTD is not set
CONFIG_OF_BOARD_SETUP=y
CONFIG_BOARD_EARLY_INIT_F=y
CONFIG_USE_PREBOOT=y
CONFIG_BOOTDELAY=8
CONFIG_BUTTON_CMD=y
CONFIG_SYS_PBSIZE=1024
# CONFIG_DISPLAY_CPUINFO is not set
CONFIG_DISPLAY_BOARDINFO_LATE=y
CONFIG_HUSH_PARSER=y
CONFIG_SYS_PROMPT="SBE1V1K> "
CONFIG_CMD_BOOTM=y
CONFIG_CMD_MMC=y
CONFIG_CMD_PART=y
CONFIG_CMD_GPT=y
CONFIG_CMD_PING=y
CONFIG_CMD_DHCP=y
CONFIG_CMD_TFTPBOOT=y
CONFIG_OF_LIVE=y
CONFIG_ENV_OVERWRITE=y
CONFIG_ENV_SOURCE_FILE="sbe1v1k-chainloader"
# CONFIG_CMD_SAVEENV is not set
# CONFIG_ENV_IS_IN_MMC is not set
CONFIG_ENV_IS_NOWHERE=y
CONFIG_NET_RANDOM_ETHADDR=y
CONFIG_RANDOM_UUID=y
CONFIG_NET_LWIP=y
CONFIG_PROT_TCP_LWIP=y
CONFIG_LWIP_TCP_WND=65535
CONFIG_HTTPD_RECOVERY=y
CONFIG_SYS_RX_ETH_BUFFER=128
CONFIG_REGMAP=y
CONFIG_SYSCON=y
CONFIG_CLK=y
CONFIG_CLK_QCOM_IPQ9574=y
CONFIG_DM_PWM=y
CONFIG_PWM_QCOM_IPQ=y
CONFIG_MSM_GPIO=y
CONFIG_GPIO_HOG=y
CONFIG_BUTTON=y
CONFIG_BUTTON_GPIO=y
# CONFIG_I2C is not set
# CONFIG_INPUT is not set
CONFIG_MISC=y
CONFIG_QCOM_GENI=y
CONFIG_MMC_SDHCI=y
CONFIG_MMC_SDHCI_ADMA=y
CONFIG_MMC_SDHCI_MSM=y
CONFIG_MTD=y
CONFIG_PHYLIB=y
CONFIG_PHYLIB_10G=y
CONFIG_DM_MDIO=y
CONFIG_MDIO_IPQ4019=y
CONFIG_DM_ETH_PHY=y
CONFIG_PHY_QCA_8075=y
CONFIG_PHY_QCA_8081=y
CONFIG_QCOM_NSS_SWITCH=y
CONFIG_ETH_IPQ9574=y
CONFIG_ETH_LOW_MEM=y
CONFIG_ETH_MAX_MAC=6
CONFIG_ETH_MAX_UNIPHY=3
CONFIG_RGMII=y
CONFIG_PHY=y
CONFIG_PHY_QCOM_QMP_UFS=y
CONFIG_PHY_QCOM_QUSB2=y
CONFIG_PINCTRL=y
CONFIG_PINCONF=y
CONFIG_PINCTRL_QCOM_IPQ9574=y
CONFIG_DEBUG_UART_ANNOUNCE=y
CONFIG_MSM_SERIAL=y
CONFIG_SOC_QCOM=y
```

## drivers/net/qcom/Kconfig
```kconfig
config QCOM_NSS_SWITCH
	bool "Qualcomm IPQ NSS/PPE Ethernet support"
	depends on DM
	select PHYLIB
	select DM_ETH
	select DM_MDIO
	select REGMAP
	select SYSCON
	help
	  Enable the NSS/PPE Ethernet datapath used by Qualcomm IPQ SoCs.

config ETH_IPQ9574
	bool "Qualcomm IPQ9574 NSS/PPE Ethernet support"
	depends on QCOM_NSS_SWITCH && ARCH_SNAPDRAGON
	default y if QCOM_NSS_SWITCH
	help
	  Enable IPQ9574-specific port, clock and PPE setup.

config ETH_LOW_MEM
	bool "Use small descriptor rings for Qualcomm IPQ Ethernet"
	depends on QCOM_NSS_SWITCH
	default n

config ETH_MAX_MAC
	int "Maximum Qualcomm IPQ Ethernet MAC ports"
	depends on QCOM_NSS_SWITCH
	default 6

config ETH_MAX_UNIPHY
	int "Maximum Qualcomm IPQ UNIPHY blocks"
	depends on QCOM_NSS_SWITCH
	default 3
```
